## config/boards/shields/chipper/Kconfig.defconfig
```kconfig
if SHIELD_CHIPPER_LEFT || SHIELD_CHIPPER_DONGLE_XIAO || SHIELD_CHIPPER_DONGLE_NANO

config ZMK_KEYBOARD_NAME
	default "Chipper"

config ZMK_SPLIT_BLE_ROLE_CENTRAL
	default y

endif

if SHIELD_CHIPPER_RIGHT || SHIELD_CHIPPER_PERIPHERAL_LEFT

config ZMK_KEYBOARD_NAME
	default "Chipper Peripheral"
	
endif

if SHIELD_CHIPPER_LEFT || SHIELD_CHIPPER_RIGHT || SHIELD_CHIPPER_PERIPHERAL_LEFT || SHIELD_CHIPPER_DONGLE_XIAO || SHIELD_CHIPPER_DONGLE_NANO

config ZMK_SPLIT
	default y
 
if ZMK_DISPLAY

config I2C
    default y

config SSD1306
    default y

endif # ZMK_DISPLAY

if SHIELD_CHIPPER_DONGLE_XIAO && ZMK_DISPLAY
  
choice ZMK_DISPLAY_WORK_QUEUE
    default ZMK_DISPLAY_WORK_QUEUE_DEDICATED
endchoice

endif

if LVGL

config LV_Z_VDB_SIZE
    default 64

config LV_DPI_DEF
    default 148

config LV_Z_BITS_PER_PIXEL
    default 1

choice LV_COLOR_DEPTH
    default LV_COLOR_DEPTH_1
endchoice

endif # LVGL

endif
```

## config/boards/shields/chipper/Kconfig.shield
```kconfig
config SHIELD_CHIPPER_LEFT
	def_bool $(shields_list_contains,chipper_left)

config SHIELD_CHIPPER_RIGHT
	def_bool $(shields_list_contains,chipper_right)

config SHIELD_CHIPPER_DONGLE_NANO
	def_bool $(shields_list_contains,chipper_dongle_nano)

config SHIELD_CHIPPER_DONGLE_XIAO
	def_bool $(shields_list_contains,chipper_dongle_xiao)

config SHIELD_CHIPPER_PERIPHERAL_LEFT
	def_bool $(shields_list_contains,chipper_peripheral_left)
```

## config/boards/shields/chipper_dongle/Kconfig.shield
```kconfig
config SHIELD_CHIPPER_LEFT
	def_bool $(shields_list_contains,chipper_left)

config SHIELD_CHIPPER_RIGHT
	def_bool $(shields_list_contains,chipper_right)

config SHIELD_CHIPPER_DONGLE
	def_bool $(shields_list_contains,chipper_dongle)

config SHIELD_CHIPPER_PERIPHERAL_LEFT
    def_bool $(shields_list_contains,chipper_peripheral_left)
```

## config/west.yml
```yaml
manifest:
  remotes:
    - name: upstream
      url-base: https://github.com/zmkfirmware
    - name: urob
      url-base: https://github.com/urob
    - name: caksoylar
      url-base: https://github.com/caksoylar
    - name: m165437 
      url-base: https://github.com/M165437
    - name: bluedrink9
      url-base: https://github.com/bluedrink9

  projects:
    - name: zmk
      remote: urob
      revision: main
      import: app/west.yml
    - name: zmk-rgbled-widget
      remote: caksoylar
      revision: main
    - name: zmk-helpers
      remote: urob
      revision: main
    - name: nice-view-gem
      remote: m165437
      revision: main
    - name: zmk-poor-mans-led-indicator
      remote: bluedrink9
      revision: main

  self:
    path: config
```
